## configs/qcm6490-fairphone-fp5_defconfig
```kconfig
# Configuration for building U-Boot for the Fairphone 5 (FP5)
# Based on Qualcomm QCM6490 ("Kodiak") platform

#include "qcm6490_defconfig"

CONFIG_DEFAULT_DEVICE_TREE="qcom/qcm6490-fairphone-fp5"
```
